## layers/meta-rpi5-rauc/conf/layer.conf
```bitbake
# Layer configuration for meta-rpi5-rauc
# =======================================

# Layer name and priority
BBPATH .= ":${LAYERDIR}"

BBFILES += "${LAYERDIR}/recipes-*/*/*.bb \
            ${LAYERDIR}/recipes-*/*/*.bbappend"

BBFILE_COLLECTIONS += "meta-rpi5-rauc"
BBFILE_PATTERN_meta-rpi5-rauc = "^${LAYERDIR}/"
BBFILE_PRIORITY_meta-rpi5-rauc = "10"

LAYERDEPENDS_meta-rpi5-rauc = "core raspberrypi rauc"
LAYERSERIES_COMPAT_meta-rpi5-rauc = "scarthgap"

# Add our WIC files to the search path
WKS_FILE_DEPENDS:append = " dosfstools-native mtools-native e2fsprogs-native"

# Enable U-Boot with extlinux distro boot
RPI_USE_U_BOOT = "1"

RPI_EXTRA_IMAGE_BOOT_FILES = "${KERNEL_IMAGETYPE} u-boot.bin;${SDIMG_KERNELIMAGE}"

IMAGE_BOOT_FILES:append = " extlinux/extlinux.conf;extlinux/extlinux.conf"
IMAGE_BOOT_FILES:remove = "boot.scr"

do_image[depends] += "rpi5-rauc-bootfiles:do_deploy"

# Completely exclude upstream rpi-u-boot-scr from being parsed/built
BBMASK += "meta-raspberrypi/recipes-bsp/rpi-u-boot-scr/"
```

## layers/meta-rpi5-rauc/wic/rpi5-rauc-ab.wks
```
# Raspberry Pi 5 A/B Partition Layout for RAUC
# =============================================
# Target: 32GB SD Card
#
# Partition Layout:
#   1. boot      - 256MB  FAT32  - RPi firmware, kernel, DTBs
#   2. rootfs_a  - 8GB    ext4   - Root filesystem Slot A (active)
#   3. rootfs_b  - 8GB    ext4   - Root filesystem Slot B (inactive)
#   4. data      - ~12GB  ext4   - Persistent data partition
#
# Total: ~28GB used, leaving headroom for "32GB" cards (which are smaller in GiB)

# Use an MBR partition table for maximum Raspberry Pi boot firmware compatibility
bootloader --ptable msdos

# Boot partition (FAT32 for RPi firmware compatibility)
part /boot --source bootimg-partition --ondisk mmcblk0 --fstype=vfat --label boot --active --align 4096 --fixed-size 256M

# Root filesystem A (primary slot)
part / --source rootfs --ondisk mmcblk0 --fstype=ext4 --label rootfs_a --align 4096 --fixed-size 8192M

# Root filesystem B (secondary slot for updates)
part --source rootfs --ondisk mmcblk0 --fstype=ext4 --label rootfs_b --align 4096 --fixed-size 8192M

# Persistent data partition (fills remaining space)
part /data --ondisk mmcblk0 --fstype=ext4 --label data --align 4096 --fixed-size 12000M
```
